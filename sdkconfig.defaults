## sdkconfig.defaults
```kconfig
CONFIG_BOOTLOADER_COMPILER_OPTIMIZATION_PERF=y
CONFIG_BOOTLOADER_LOG_LEVEL_NONE=y
CONFIG_BOOTLOADER_APP_ROLLBACK_ENABLE=y
CONFIG_BOOTLOADER_SKIP_VALIDATE_ALWAYS=y
CONFIG_ESPTOOLPY_FLASHMODE_QIO=y
CONFIG_ESPTOOLPY_FLASHSIZE_8MB=y
CONFIG_ESPTOOLPY_HEADER_FLASHSIZE_UPDATE=y
CONFIG_PARTITION_TABLE_CUSTOM=y
CONFIG_COMPILER_OPTIMIZATION_PERF=y
CONFIG_COMPILER_STACK_CHECK_MODE_NORM=y
CONFIG_COMPILER_WARN_WRITE_STRINGS=y
CONFIG_ESP_MAIN_TASK_STACK_SIZE=4096
# CONFIG_ESP_TASK_WDT_CHECK_IDLE_TASK_CPU0 is not set
CONFIG_ESP_COREDUMP_ENABLE_TO_FLASH=y
CONFIG_ESP_COREDUMP_FLASH_NO_OVERWRITE=y
CONFIG_ESP_COREDUMP_STACK_SIZE=1280
CONFIG_ESP_COREDUMP_SUMMARY_STACKDUMP_SIZE=4096
CONFIG_FATFS_CODEPAGE_850=y
CONFIG_FREERTOS_GENERATE_RUN_TIME_STATS=y
CONFIG_IEEE802154_RX_BUFFER_SIZE=100
CONFIG_IEEE802154_TIMING_OPTIMIZATION=y
CONFIG_LOG_DEFAULT_LEVEL_ERROR=y
CONFIG_LOG_MAXIMUM_LEVEL_DEBUG=y
# CONFIG_MBEDTLS_HARDWARE_AES is not set
# CONFIG_MBEDTLS_HARDWARE_MPI is not set
# CONFIG_MBEDTLS_HARDWARE_SHA is not set
CONFIG_MBEDTLS_KEY_EXCHANGE_ECJPAKE=y
CONFIG_MBEDTLS_SSL_PROTO_DTLS=y
CONFIG_MBEDTLS_ECJPAKE_C=y
CONFIG_ZB_ENABLED=y
CONFIG_ZB_ZED=y
```

## sdkconfig.defaults.esp32h2
```kconfig
CONFIG_ESPTOOLPY_FLASHMODE_QIO=y
CONFIG_ESPTOOLPY_FLASHSIZE_4MB=y
CONFIG_PARTITION_TABLE_CUSTOM=y
CONFIG_PARTITION_TABLE_CUSTOM_FILENAME="partitions.esp32-h2-devkitm-1.csv"
```

## src/Kconfig
```kconfig
menu "Candle Dribbler"
	depends on ZB_ENABLED

config NUTT_MAX_LIGHTS
	int "Number of lights supported"
	range 0 8
	default 4
	help
		Configure number of lights that are supported.

config NUTT_SWITCH_ACTIVE_LOW
	bool "Switches are active low"
	default y
	help
		Configure whether switch signalling is active low or high.

config NUTT_RELAY_ACTIVE_LOW
	bool "Relays are active low"
	default y
	help
		Configure whether relay signalling is active low or high.

config NUTT_UI_LED_BRIGHTNESS
	int "RGB LED brightness"
	range 0 255
	default 8
	help
		Configure LED brightness.

config NUTT_ZIGBEE_ROLE_ROUTER
	bool
	default y if ZB_ZCZR

menuconfig NUTT_SUPPORT_OTA
	bool "Support OTA"
	default n
	help
		Support OTA (over the air) updates. These are slow and take a long time
		to complete. They're also defined in a restrictive way that expects you
		to have a Zigbee manufacturer ID (limited to 65535 values!) and wait for
		the device to pull updates from another Zigbee device/coordinator on the
		network. Updates will be marked valid automatically when a connection is
		established to a network.

if NUTT_SUPPORT_OTA
	config NUTT_OTA_MANUFACTURER_ID
		hex "Manufacturer ID"
		range 0x0000 0xfffe
		default 0
		help
			Configure Zigbee manufacturer ID for OTA updates.

	config NUTT_OTA_IMAGE_TYPE_ID
		hex "Image Type ID"
		range 0x0000 0xfffe
		default 0
		help
			Configure image type ID (to uniquely identify this device model)
			for OTA updates.

    config NUTT_OTA_FILE_VERSION_FROM_GIT_COMMIT
		bool "Use Git commit timestamp as OTA file version"
		default n
		help
			Configure the current file version (to identify which builds are
			newer) automatically using the timestamp of the current Git commit.

			This may go badly wrong while bisecting with older versions on a
			network with an upgrade server.

	config NUTT_OTA_FILE_VERSION
		hex "File Version"
		range 0x00000000 0xffffffff
		default 0
		depends on !NUTT_OTA_FILE_VERSION_FROM_GIT_COMMIT
		help
			Configure the current file version (to identify which builds are
			newer).
endif

endmenu
```
